## meta-agl-early/conf/layer.conf
```bitbake
# We have a conf and classes directory, add to BBPATH
BBPATH .= ":${LAYERDIR}"

# We have recipes-* directories, add to BBFILES
BBFILES += "${LAYERDIR}/recipes-*/*/*.bb \
    ${LAYERDIR}/recipes-*/*/*.bbappend"

BBFILE_COLLECTIONS += "agl-early"
BBFILE_PATTERN_agl-early = "^${LAYERDIR}/"
BBFILE_PRIORITY_agl-early = "100"

########### 4A HAL configuration #############

4A_RUNTIME_HAL_FALLBACK = "2ch-generic-usb"

4A_RUNTIME_HAL = "2ch-generic-usb"
4A_RUNTIME_HAL_m3ulcb = "rcar-m3 rcar-m3kf"
4A_RUNTIME_HAL_h3ulcb = "rcar-m3 rcar-m3kf"
4A_RUNTIME_HAL_intel-corei7-64 = "intel-minnow intel-upsquared-hdmi"
4A_RUNTIME_HAL_qemux86-64 = "intel-qemu"

4A_RUNTIME_HAL_AUTODETECT = "yes"
```
